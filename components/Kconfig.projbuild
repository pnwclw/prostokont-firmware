## components/Kconfig.projbuild
```kconfig
menu "Display Board"

choice DISPLAY_BOARD
    prompt "Board"

    config INKPLATE_BOARD_INKPLATE2
        bool "Inkplate2"

    config INKPLATE_BOARD_INKPLATE4
        bool "Inkplate4"

    config INKPLATE_BOARD_INKPLATE5
        bool "Inkplate5"

    config INKPLATE_BOARD_INKPLATE6
        bool "Inkplate6"
    
    config INKPLATE_BOARD_INKPLATE6COLOR
        bool "Inkplate6 Color"
    
    config INKPLATE_BOARD_INKPLATE6FLICK
        bool "Inkplate6 Flick"

    config INKPLATE_BOARD_INKPLATE10
        bool "Inkplate10"

    config INKPLATE_BOARD_INKPLATE13
        bool "Inkplate13"

    config WAVESHARE_BOARD_WAVESHARE13
        bool "Waveshare 13.3 inch E6"
        help
            Requires an ESP32-S3 board/module with external PSRAM. The driver
            keeps a 1200x1600 4-bit framebuffer in PSRAM.

endchoice

endmenu

menu "Wi-Fi Configuration"

config WIFI_SSID
	string "WiFi SSID"
	default ""

config WIFI_PASSWORD
	string "WiFi Password"
	default ""

endmenu
```

## sdkconfig.defaults
```kconfig
CONFIG_BT_ENABLED=y
CONFIG_BT_NIMBLE_ENABLED=y
CONFIG_BT_NIMBLE_50_FEATURE_SUPPORT=n

CONFIG_PARTITION_TABLE_SINGLE_APP_LARGE=y
CONFIG_SPIRAM=y
# CONFIG_SPIRAM_MODE_QUAD is not set
CONFIG_SPIRAM_MODE_OCT=y
# CONFIG_SPIRAM_SPEED_40M is not set
CONFIG_SPIRAM_SPEED_80M=y
CONFIG_SPIRAM_BOOT_INIT=y
# CONFIG_ESPTOOLPY_FLASHSIZE_2MB is not set
CONFIG_ESPTOOLPY_FLASHSIZE_32MB=y
CONFIG_ESP_MAIN_TASK_STACK_SIZE=16384
CONFIG_ESP_TLS_INSECURE=y
CONFIG_ESP_TLS_SKIP_SERVER_CERT_VERIFY=y
```
